## drivers/infiniband/sw/rdmavt/Kconfig
```kconfig
config INFINIBAND_RDMAVT
	tristate "RDMA verbs transport library"
	default m
	---help---
	This is a common software verbs provider for RDMA networks.
```
